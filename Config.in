## configs/kubos-qemu-x86_64_defconfig
```kconfig
# vim: ft=Kconfig
BR2_x86_64=y
BR2_CCACHE=y
# BR2_CCACHE_USE_BASEDIR is not set
BR2_TOOLCHAIN_BUILDROOT_GLIBC=y
BR2_TOOLCHAIN_BUILDROOT_CXX=y
BR2_GCC_ENABLE_LTO=y
BR2_PACKAGE_HOST_GDB=y
BR2_PACKAGE_HOST_GDB_TUI=y
BR2_PACKAGE_HOST_GDB_PYTHON=y
BR2_BINUTILS_VERSION_2_27_X=y
BR2_TARGET_GENERIC_GETTY_PORT="tty1"
BR2_SYSTEM_DHCP="eth0"
BR2_LINUX_KERNEL=y
BR2_LINUX_KERNEL_CUSTOM_VERSION=y
BR2_LINUX_KERNEL_CUSTOM_VERSION_VALUE="4.4.23"
BR2_PACKAGE_HOST_LINUX_HEADERS_CUSTOM_4_4=y

BR2_TARGET_GENERIC_ISSUE="Welcome to KubOS Linux"
BR2_TARGET_GENERIC_ROOT_PASSWD="Kubos123"

BR2_LINUX_KERNEL_USE_CUSTOM_CONFIG=y
BR2_LINUX_KERNEL_CUSTOM_CONFIG_FILE="${BR2_EXTERNAL_KUBOS_LINUX_PATH}/board/kubos/qemu-x86_64/linux-kubos.config"

BR2_LINUX_KERNEL_LZMA=y
BR2_PACKAGE_BUSYBOX_CONFIG="${BR2_EXTERNAL_KUBOS_LINUX_PATH}/board/kubos/qemu-x86_64/busybox-kubos.config"
BR2_TARGET_ROOTFS_EXT2=y
BR2_TARGET_ROOTFS_EXT2_4=y
BR2_TARGET_ROOTFS_EXT2_LABEL="rootfs"
BR2_TARGET_ROOTFS_ISO9660=y
BR2_TARGET_GRUB=y # needed for ISO image

#BR2_TARGET_UBOOT=y
#BR2_TARGET_UBOOT_BUILD_SYSTEM_KCONFIG=y
#BR2_TARGET_UBOOT_PATCH="${BR2_EXTERNAL_KUBOS_LINUX_PATH}/board/kubos/at91sam9g20isis/u-boot"
#BR2_TARGET_UBOOT_USE_CUSTOM_CONFIG=y
#BR2_TARGET_UBOOT_CUSTOM_CONFIG_FILE="${BR2_EXTERNAL_KUBOS_LINUX_PATH}/board/kubos/at91sam9g20isis/at91sam9g20isis_config"
#BR2_PACKAGE_HOST_SAM_BA=y

#BR2_PACKAGE_EUDEV=y
#BR2_ROOTFS_DEVICE_CREATION_DYNAMIC_EUDEV=y

BR2_ROOTFS_OVERLAY="${BR2_EXTERNAL_KUBOS_LINUX_PATH}/board/kubos/qemu-x86_64/overlay"

BR2_INIT_SYSTEMD=y

BR2_PACKAGE_SYSTEMD=y
BR2_PACKAGE_UTIL_LINUX=y
BR2_PACKAGE_UTIL_LINUX_BINARIES=y
BR2_PACKAGE_LIBGLIB2=y

BR2_PACKAGE_MAKE=y
BR2_PACKAGE_GIT=y
BR2_PACKAGE_BINUTILS=y
BR2_PACKAGE_LIBTOOL=y
BR2_PACKAGE_XE_GUEST_UTILITIES=y
BR2_SYSTEM_BIN_SH_BASH=y
BR2_PACKAGE_GAWK=y
```

## package/xe-guest-utilities/Config.in
```kconfig
comment "XenServer Guest utils needs a toolchain w/ threads"
	depends on BR2_PACKAGE_HOST_GO_ARCH_SUPPORTS && \
		BR2_PACKAGE_HOST_GO_CGO_LINKING_SUPPORTS
	depends on !BR2_TOOLCHAIN_HAS_THREADS

config BR2_PACKAGE_XE_GUEST_UTILITIES
	bool "xe-guest-utilities"
	depends on BR2_PACKAGE_HOST_GO_ARCH_SUPPORTS
	depends on BR2_PACKAGE_HOST_GO_CGO_LINKING_SUPPORTS
	depends on BR2_TOOLCHAIN_HAS_THREADS
	help
	  XenServer Guest utils

	  https://github.com/xenserver/xe-guest-utilities
```
